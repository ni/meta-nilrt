## recipes-bsp/zynq-itb/files/linux-default.its
```
/*
 * Runmode image tree
 */

/dts-v1/;

/ {
	description = "LV Comms";
	version = "2.0";
	#address-cells = <1>;

	images {

		bootscript@1 {
			description = "Booting nilrt";
			data = /incbin/("./bootscript-default.txt");
			type = "script";
			arch = "arm";
			compression = "none";
			hash@1 {
				algo = "crc32";
			};
		};

	};
};
```

## recipes-bsp/zynq-itb/files/linux-fw-migrate.its
```
/dts-v1/;

/ {
	description = "LV Comms";
	version = "2.0";
	#address-cells = <1>;

	images {

		bootscript@1 {
			description = "Booting migrate image";
			data = /incbin/("./bootscript-fw-migrate.txt");
			type = "script";
			arch = "arm";
			compression = "none";
			hash@1 {
				algo = "crc32";
			};
		};

	};
};
```

## recipes-bsp/zynq-itb/files/linux-safemode.its
```
/dts-v1/;

/ {
	description = "LV Comms";
	version = "2.0";
	#address-cells = <1>;

	images {

		bootscript@1 {
			description = "Booting safemode";
			data = /incbin/("./bootscript-safemode.txt");
			type = "script";
			arch = "arm";
			compression = "none";
			hash@1 {
				algo = "crc32";
			};
		};

	};
};
```

## recipes-bsp/zynq-itb/files/nxg_redirect_runmode_boot.its
```
/dts-v1/;

/ {
	description = "Redirect u-boot runmode bootflow to NXG boot.scr";
	version = "2.0";
	#address-cells = <1>;

	images {

		bootscript@1 {
			description = "Booting nilrt";
			data = /incbin/("./nxg_redirect_runmode_boot.txt");
			type = "script";
			arch = "arm";
			compression = "none";
			hash@1 {
				algo = "crc32";
			};
		};

	};
};
```

## recipes-bsp/zynq-itb/files/nxg_redirect_safemode_boot.its
```
/dts-v1/;

/ {
	description = "Redirect u-boot safemode bootflow to NXG boot.scr";
	version = "2.0";
	#address-cells = <1>;

	images {

		bootscript@1 {
			description = "Booting safemode";
			data = /incbin/("./nxg_redirect_safemode_boot.txt");
			type = "script";
			arch = "arm";
			compression = "none";
			hash@1 {
				algo = "crc32";
			};
		};

	};
};
```

## recipes-core/images/lvcomms-nilrt-image.n310.wks
```
part /boot --source bootimg-partition --ondisk mmcblk0 --fstype vfat --label boot --align 24576 --active --size 16383k
part / --source rootfs --ondisk mmcblk0 --fstype=ext4 --label rootfs --align 4
```

## scripts/lib/wic/canned-wks/mk-NI-hybridiso.wks
```
# short-description: Create a hybrid ISO image
# long-description: Creates an EFI and legacy bootable hybrid ISO image
# which can be used on optical media as well as USB media.

part /boot --source isoimage-isohybrid --sourceparams="loader=grub-efi,image_name=NI_RECOVERY_IMG" --ondisk cd --label NIRECOVERY --fstype=ext3

# note that --append is ignored by grub when using a configfile
# and only processed by syslinux as configured below
bootloader --configfile="grub.cfg" --append="restore=provision"
```

## scripts/lib/wic/canned-wks/nilrt-restore-mode-image.x64.wks
```
# short-description: Create a hybrid ISO image
# long-description: Creates an EFI and legacy bootable hybrid ISO image
# which can be used on optical media as well as USB media.

part /boot --source isoimage-isohybrid --sourceparams="esp_label=NIRECOVERY,esp_extra_blocks=5000,loader=grub-efi,image_name=nilrt-restore-mode-image.x64" --ondisk cd --label NIRECOVERY-CD

# note that --append is ignored by grub when using a configfile
# and only processed by syslinux as configured below
bootloader --configfile="grub.cfg" --append="restore=provision console=ttyS0"
```

## scripts/lib/wic/canned-wks/restore-mode-image.x64.wks
```
# short-description: Create a hybrid ISO image
# long-description: Creates an EFI and legacy bootable hybrid ISO image
# which can be used on optical media as well as USB media.

part /boot --source isoimage-isohybrid --sourceparams="loader=grub-efi,image_name=restore-mode-image.x64" --ondisk cd --label NIRECOVERY

# note that --append is ignored by grub when using a configfile
# and only processed by syslinux as configured below
bootloader --configfile="grub.cfg" --append="restore=provision console=ttyS0"
```
