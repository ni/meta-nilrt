## conf/bblayers.conf
```bitbake
# LAYER_CONF_VERSION is increased each time build/conf/bblayers.conf
# changes incompatibly
LCONF_VERSION = "5"

BBPATH = "${TOPDIR}"
BBFILES ?= ""

BBLAYERS ?= " \
  ${GIT_REPODIR}/openembedded-core/meta \
  ${GIT_REPODIR}/meta-openembedded/meta-oe \
  ${GIT_REPODIR}/meta-openembedded/meta-xfce \
  ${GIT_REPODIR}/meta-openembedded/meta-networking \
  ${GIT_REPODIR}/meta-openembedded/meta-filesystems \
  ${GIT_REPODIR}/meta-openembedded/meta-gnome \
  ${GIT_REPODIR}/meta-openembedded/meta-python \
  ${GIT_REPODIR}/meta-openembedded/meta-ruby \
  ${GIT_REPODIR}/meta-nilrt \
  ${GIT_REPODIR}/meta-mingw \
  ${GIT_REPODIR}/meta-selinux \
  "

BBLAYERS_NON_REMOVABLE ?= " \
  ${GIT_REPODIR}/openembedded-core/meta \
  "
```

## conf/bblayers.conf.sample
```bitbake
# LAYER_CONF_VERSION is increased each time build/conf/bblayers.conf
# changes incompatibly
LCONF_VERSION = "5"

BBPATH = "${TOPDIR}"
BBFILES ?= ""

BBLAYERS ?= " \
	${GIT_REPODIR}/meta-cloud-services \
	${GIT_REPODIR}/meta-cloud-services/meta-openstack \
	${GIT_REPODIR}/meta-ivi/meta-ivi \
	${GIT_REPODIR}/meta-java \
	${GIT_REPODIR}/meta-mingw \
	${GIT_REPODIR}/meta-mono \
	${GIT_REPODIR}/meta-nilrt \
	${GIT_REPODIR}/meta-openembedded/meta-filesystems \
	${GIT_REPODIR}/meta-openembedded/meta-gnome \
	${GIT_REPODIR}/meta-openembedded/meta-initramfs \
	${GIT_REPODIR}/meta-openembedded/meta-multimedia \
	${GIT_REPODIR}/meta-openembedded/meta-networking \
	${GIT_REPODIR}/meta-openembedded/meta-oe \
	${GIT_REPODIR}/meta-openembedded/meta-perl \
	${GIT_REPODIR}/meta-openembedded/meta-python \
	${GIT_REPODIR}/meta-openembedded/meta-webserver \
	${GIT_REPODIR}/meta-openembedded/meta-xfce \
	${GIT_REPODIR}/meta-qt5 \
	${GIT_REPODIR}/meta-qt5-extra \
	${GIT_REPODIR}/meta-rauc \
	${GIT_REPODIR}/meta-sdr \
	${GIT_REPODIR}/meta-security \
	${GIT_REPODIR}/meta-selinux \
	${GIT_REPODIR}/meta-virtualization \
	${GIT_REPODIR}/openembedded-core/meta \
"

BBLAYERS_NON_REMOVABLE ?= " \
	${GIT_REPODIR}/openembedded-core/meta \
"
```

## conf/distro/nilrt-academic.conf
```bitbake
require nilrt.inc

DISTRO_NAME = "NI Linux Real-Time - Academic"

DISTRO_VERSION = "8.14"

NILRT_FEED_NAME = "2023"

DISTRO_FEATURES_append_x64 = "\
        x11 \
        opengl \
"

VIRTUAL-RUNTIME_xserver_common = "xserver-common"

VIRTUAL-RUNTIME_mountpoint ?= "busybox"

# on older NILRT distro flavors the kernel is installed in non-standard paths
# for backward compatibility
KERNEL_IMAGEDEST = "boot/runmode"

# Needs to change thanks to NIAuth
# - cf oe-core base-files/base-files/profile
# - cf oe-core base-files/base-files_3.0.14.bb
ROOT_HOME = "/home/admin"

IMAGE_LINGUAS ?= "en-us en-us.iso-8859-1"


## OPKG FEEDS ##

# Overwrite the feed URIs from nilrt.inc, since the academic feeds need their
# own release namespace.
NILRT_FEEDS_URI_RELEASE = "${NILRT_FEEDS_URI}/academic/${NILRT_FEED_NAME}"
PACKAGE_FEED_URIS = "${NILRT_FEEDS_URI_RELEASE}"
```

## conf/distro/nilrt-nxg.conf
```bitbake
require nilrt.inc

DISTRO_NAME = "NI Linux Real-Time NXG"

DISTRO_VERSION = "100.1"

NILRT_RELEASE_NAME = "Panda"

DISTRO_FEATURES += "\
        x11 \
        opengl \
        bluetooth \
        bluez5 \
"

VIRTUAL-RUNTIME_mountpoint = "util-linux-mountpoint"

PREFERRED_PROVIDER_iasl = "acpica"
PREFERRED_PROVIDER_make-native = "make-native"
PREFERRED_PROVIDER_virtual/java-initial-native = "cacao-initial-native"
PREFERRED_PROVIDER_virtual/java-native = "cacao-native"

# meta-openstack uses overly-restrictive version preferences, we
# avoid build warnings by relaxing them
PREFERRED_VERSION_python-futures = "3.%"
PREFERRED_VERSION_python-sqlalchemy = "1.%"
PREFERRED_VERSION_python-greenlet = "0.4.%"

PREFERRED_VERSION_sepolgen = "1.2.1+git%"

IMAGE_LINGUAS ?= "en-us"


## OPKG SOURCE FEEDS ##
# NI Proprietary Software
NI_SUBFEED_URI                           ?= "${NILRT_MACHINE_FEED_URI}/ni"
PACKAGE_FEED_URIS_ADDITIONAL[NI-software] = "${NI_SUBFEED_URI}"

# ARM Kernel Feed
NI_ARM_KERNEL_SUBFEED_NAME              = "cortexa9-vfpv3-kernel"
NIARMKernel_SUBFEED_URI                ?= "${IPK_NI_SUBFEED_URI}/${NI_ARM_KERNEL_SUBFEED_NAME}"
PACKAGE_FEED_URIS_ADDITIONAL_xilinx-zynq[NI-kernel] = "${NIARMKernel_SUBFEED_URI}"


## BUILD FROM FEEDS ##

# Tell OE to build image from feeds
BUILD_IMAGES_FROM_FEEDS = "1"

# Get NIOE packages from local deploy feed and NI packages from web feed
IPK_NIOE_SUBFEED_URI ?= "file://${DEPLOY_DIR_IPK}"

# In production, the IPK_NI_SUBFEED_URI is set to the local path to the
# *latest* export of the NIFeeds. In dev and non-NI environments, we set it to
# the NIFeeds URL on the configured feed server.
IPK_NI_SUBFEED_URI ?= "${NI_SUBFEED_URI}"

# Configure feed URIs for image builds
IPK_FEED_URIS += "\
    NIOE-all##${IPK_NIOE_SUBFEED_URI}/all \
    NIOE-${MACHINE}##${IPK_NIOE_SUBFEED_URI}/${MACHINE} \
    NIOE-${TUNE_PKGARCH}##${IPK_NIOE_SUBFEED_URI}/${TUNE_PKGARCH} \
    NI-software##${IPK_NI_SUBFEED_URI} \
"

IPK_FEED_URIS_append_armv7a = " \
    NI-${NI_ARM_KERNEL_SUBFEED_NAME}##${NIARMKernel_SUBFEED_URI} \
"
```

## conf/distro/nilrt.inc
```bitbake
MAINTAINER = "NI Linux Real-Time Maintainers <nilrt@ni.com>"

TARGET_VENDOR = "-nilrt"

GRUB_BRANCH = "nilrt/19.0"

# Inherit the default LIBC features superset from OE-core
DISTRO_FEATURES += "${DISTRO_FEATURES_LIBC}"

# Common features enabled on all NILRT flavours
DISTRO_FEATURES += "\
        argp \
        efi \
        ext2 \
        largefile \
        usbgadget \
        usbhost \
        wifi \
        xattr \
        zeroconf \
        pci \
        sysvinit \
        pam \
        ptest \
        selinux \
	virtualization \
"

# Because NIRLT uses opkg so intimately, assert that the rootfs should always
# be made of IPKs.
PACKAGE_CLASSES_prepend =+ "package_ipk"

# Clean *most* package work directories
INHERIT += " rm_work "
RM_WORK_EXCLUDE += " \
	niconsole-image \
	niconsole-image-safe \
	restore-mode-image \
	safemode-restore-image \
"

# Various packages dynamically add users and groups to the system at package
# install time.  For programs that do not care what the uid/gid is of the
# resulting users/groups, the order of the install will determine the final
# uid/gid.  This can lead to non-deterministic uid/gid values from one build
# to another.  Use the following settings to specify that all user/group adds
# should be created based on a static passwd/group file.
#
# Note, if you enable or disable the useradd-staticids in a configured system,
# the TMPDIR may contain incorrect uid/gid values.  Clearing the TMPDIR
# will correct this condition.
#
# By default the system looks in the BBPATH for files/passwd and files/group
# the default can be overriden by specifying USERADD_UID/GID_TABLES.
#
USERADDEXTENSION = "useradd-staticids"
#USERADD_UID_TABLES = "files/passwd"
#USERADD_GID_TABLES = "files/group"
#
# In order to prevent generating a system where a dynamicly assigned uid/gid
# can exist, you should enable the following setting.  This will force the
# system to error out if the user/group name is not defined in the
# files/passwd or files/group (or specified replacements.)
USERADD_ERROR_DYNAMIC = "1"

LVRT_USER = "lvuser"
LVRT_GROUP = "ni"

SDK_VENDOR = "-nilrtsdk"
SDK_VERSION := "${@'${DISTRO_VERSION}'}"

LOCALCONF_VERSION = "1"
LAYER_CONF_VERSION ?= "5"

VIRTUAL-RUNTIME_graphical_init_manager = "xserver-xfce-init"

VIRTUAL-RUNTIME_base-utils-hwclock = "util-linux-hwclock"

VIRTUAL-RUNTIME_initscripts = "initscripts"

VIRTUAL-RUNTIME_init_manager = "sysvinit"

# For qemu images
VIRTUAL-RUNTIME_keymaps = ""

PREFERRED_PROVIDER_virtual/xserver ?= "xserver-xorg"

PREFERRED_PROVIDER_virtual/libgl ?= "mesa"
PREFERRED_PROVIDER_virtual/libgles1 ?= "mesa"
PREFERRED_PROVIDER_virtual/libgles2 ?= "mesa"

PREFERRED_PROVIDER_virtual/kernel ?= "linux-nilrt"

PREFERRED_RPROVIDER_java2-runtime = "openjdk-8"

PREFERRED_RPROVIDER_refpolicy = "refpolicy-standard"

PREFERRED_RPROVIDER_polarssl = "polarssl"

PREFERRED_RPROVIDER_initd-functions = "initscripts"

PREFERRED_PROVIDER_jpeg = "jpeg"
PREFERRED_PROVIDER_jpeg-native = "jpeg-native"

PREFERRED_PROVIDER_getopt = "busybox"
VIRTUAL-RUNTIME_getopt = "busybox"

OLDEST_KERNEL = "3.14.3"

QTDEMOS = "quicky fotowall"

GCCVERSION = "7.3%"

EFI_PROVIDER = "grub-efi"

INCLUDE_PYCS = "0"

DISTRO_FEATURES_BACKFILL_CONSIDERED_arm = "gobject-introspection-data"

# touchsreen calibration doesn't work with xf86-input-libinput, only with xf86-input-edev
BAD_RECOMMENDATIONS += "xf86-input-libinput"

# Do not "--enable-udev_sync" in lvm2/libdevmapper
LVM2_PACKAGECONFIG_remove_class-target = "udev"
RRECOMMENDS_libdevmapper_remove_class-target = "lvm2-udevrules"

# these bbappends are constantly stale and since we don't use them
# mask to avoid the bitbake warning noise
BBMASK += "meta-cloud-services/meta-openstack/recipes-kernel"

# Base URI to NI Linux RT's Git repository
NILRT_GIT ?= "git://github.com/ni"

# Creates ``*-lic`` subpackages for all OE recipes if enabled
LICENSE_CREATE_PACKAGE ?= "1"

# Create Packages.filelist for each feed
PACKAGE_ENABLE_FILELIST ?= "True"


## OPKG SOURCE FEEDS ##

# Root URI of all NILRT feeds
NILRT_FEEDS_URI                    ?= "http://download.ni.com/ni-linux-rt/feeds"
NILRT_FEEDS_URI_RELEASE            ?= "${NILRT_FEEDS_URI}/${NILRT_FEED_NAME}"
NILRT_MACHINE_FEED_URI_x64         ?= "${NILRT_FEEDS_URI_RELEASE}/x64"
NILRT_MACHINE_FEED_URI_xilinx-zynq ?= "${NILRT_FEEDS_URI_RELEASE}/arm"

# OE Packages with TUNEARCHes
PACKAGE_FEED_URIS       = "${NILRT_MACHINE_FEED_URI}"
PACKAGE_FEED_BASE_PATHS = "extra main"
PACKAGE_FEED_ARCHS      = "all ${MACHINE} ${TUNE_PKGARCH}"

# NI Packages, which are flat feeds
# Add additional (non-constructed) opkg sources with the pattern:
# PACKAGE_FEED_URIS_ADDITIONAL[source_name] = "source_uri"
PACKAGE_FEED_URIS_ADDITIONAL = 'fake value for PACKAGE_FEED_URIS_ADDITIONAL'

# NI distribution packages
PACKAGE_FEED_URIS_ADDITIONAL[NI-dist] = "${NILRT_FEEDS_URI}/dist"
```

## conf/layer.conf
```bitbake
# We have a conf directory, add to BBPATH
BBPATH .= ":${LAYERDIR}"

# We have a recipes directory containing .bb and .bbappend files, add to BBFILES
BBFILES += "${LAYERDIR}/recipes-*/*/*.bb \
            ${LAYERDIR}/recipes-*/*/*.bbappend"

BBFILE_COLLECTIONS += "meta-nilrt"
BBFILE_PATTERN_meta-nilrt = "^${LAYERDIR}/"
BBFILE_PRIORITY_meta-nilrt = "15"

LAYERSERIES_COMPAT_meta-nilrt = "hardknott"


## NILRT GIT REPO CONFIGURATION
NILRT_GIT_RO_PROTO ?= "git://"
NILRT_GIT_RW_PROTO ?= "https://"

NILRT_GIT_REPO_HOST ?= "github.com/ni"

NILRT_RO_GIT_URI ?= "${NILRT_GIT_RO_PROTO}${NILRT_GIT_REPO_HOST}"
NILRT_RW_GIT_URI ?= "${NILRT_GIT_RW_PROTO}${NILRT_GIT_REPO_HOST}"

NILRT_GIT ?= "${NILRT_RO_GIT_URI}"
```

## conf/local.conf
```bitbake
require common.local.conf

# Turn on UI features for x64 builds
DISTRO = "nilrt-xfce"

# NOTE: Because we are using an external CodeSourcery toolchain, which includes
# its own glibc, the following settings are more or less ignored:
#
#     ANGSTROM_GCC_VERSION
#     PREFERRED_VERSION_gcc
#     PREFERRED_VERSION_gcc
#     PREFERRED_VERSION_gcc-cross
#     PREFERRED_VERSION_gcc-cross-initial
#     PREFERRED_VERSION_gcc-cross-intermediate
#     PREFERRED_VERSION_glibc
#     PREFERRED_VERSION_glibc-intermediate

# Tell OE to build image from export feeds
BUILD_IMAGES_FROM_FEEDS = "${BUILD_FROM_FEEDS}"
# TODO: We need to remove the extra feeds from image (nirtcfg, nisdmom)
IPK_FEED_URIS += " \
           all##file://${NIOEFeeds_DEP_DIR}/feeds/ipk/all \
           ${TUNE_PKGARCH}##file://${NIOEFeeds_DEP_DIR}/feeds/ipk/${TUNE_PKGARCH} \
	   ${MACHINE}##file://${NIOEFeeds_DEP_DIR}/feeds/ipk/${MACHINE} \
	   nirtcfg##file://${nirtcfg_ipk_DEP_DIR}/installers/x64/release \
	   nisdmon##file://${nisdmon_ipk_DEP_DIR}/installers/x64/release"

PREFERRED_PROVIDER_virtual/gettext = "gettext"
```

## conf/machine/i386.conf
```bitbake
#@TYPE: Machine
#@NAME: i386

#@WEBTITLE: Generic Intel 32-bit machine

#@DESCRIPTION: Machine configuration for a generic Intel 32-bit machine

# there's no i386 include file available in OE
# i586 is an acceptable stand-in for our purposes (i.e. build host side utilities)
require conf/machine/include/tune-i586.inc

PACKAGE_EXTRA_ARCHS_tune-i586 = "${PACKAGE_EXTRA_ARCHS_tune-x86} i486 i586"
MACHINE_FEATURES += "x86"
```

## conf/machine/n310.conf
```bitbake
require xilinx-zynqhf.conf

IMAGE_FSTYPES_append = " wic "
IMAGE_BOOT_FILES = " ${KERNEL_IMAGETYPE} ${UBOOT_BINARY} ${@ '${KERNEL_IMAGE_SYMLINK_NAME}'.replace('${MACHINE}','${KERNEL_DEVICETREE}'.strip())} ${SPL_BINARYNAME} "
EXTRA_IMAGEDEPENDS_append = " \
                        dosfstools-native \
                        mtools-native \
                        ${IMAGE_DEPENDS_wic} \
"

SPL_BINARY = "spl/boot.bin"
SPL_BINARYNAME = "${@os.path.basename(d.getVar("SPL_BINARY",True))}"
UBOOT_BRANCH = "dev/bmouring/n310-rev3/cardassia/2017.01"
UBOOT_MACHINE = "ni_sulfur_rev3_config"
UBOOT_BINARY = "u-boot.img"
UBOOT_LOADADDRESS ?= "0x8000"
UBOOT_ENTRYPOINT ?= "${UBOOT_LOADADDRESS}"

KERNEL_IMAGETYPE = "uImage"
KERNEL_EXTRA_ARGS += "LOADADDR=0x8000"
KERNEL_DEVICETREE = " zynq-ni-sulfur-rev3.dtb "
KERNEL_IMAGE_SYMLINK_NAME = "${KERNEL_IMAGETYPE}-${MACHINE}"

# HACK - This is needed for wic stuff
RM_WORK_EXCLUDE_append = " ${IMAGE_BASENAME} "
```

## conf/machine/x64.conf
```bitbake
#@TYPE: Machine
#@NAME: x64 

#@WEBTITLE: Generic Intel x86 64-bit machine

#@DESCRIPTION: Machine configuration for a generic x86 64-bit machine

DEFAULTTUNE ?= "core2-64"
require conf/machine/include/tune-core2.inc
require conf/machine/include/x86-base.inc

XSERVER = "${XSERVER_X86_BASE} \
	   ${XSERVER_X86_EXT} \
	   ${XSERVER_X86_I915} \
	   ${XSERVER_X86_I965} \
	   ${XSERVER_X86_VESA} \
	   ${XSERVER_X86_FBDEV} \
	   ${XSERVER_X86_MODESETTING} \
	   mesa-driver-swrast \
	   xf86-input-vmmouse \
	   xf86-video-vmware \
	   libgl-mesa \
"
```

## conf/machine/xilinx-zynqhf.conf
```bitbake
#@TYPE: Machine
#@Name: Xilinx Zynq Platform
#@DESCRIPTION: Machine configuration for Xilinx Zynq-7000

TARGET_ARCH = "arm"
#tune for the ARM Cortex A9
DEFAULTTUNE ?= "cortexa9hf-vfpv3"
require conf/machine/include/tune-cortexa9.inc

MACHINE_ARCH = "${@[d.getVar('TUNE_PKGARCH', True), d.getVar('MACHINE', True)][bool(d.getVar('MACHINE', True))]}"

MACHINE_FEATURES = "apm ext2 vfat ethernet screen usbgadget usbhost wifi"

SERIAL_CONSOLES = "115200;ttyS0"

INITRAMFS_FSTYPES = "cpio.gz.u-boot"

# we're not building a full u-boot in OE, justfw_{print|set}env and mkimage,
# thus we use a generic machine.
UBOOT_MACHINE ?= "config"

UBOOT_LOADADDRESS ?= "0x8000"
UBOOT_ENTRYPOINT ?= "${UBOOT_LOADADDRESS}"

KERNEL_EXTRA_ARGS += "LOADADDR=0x8000"

KERNEL_IMAGETYPE ?= "uImage"

NILRT_ARM_DEVICE_CODES = "\
    762F 76D3 76D6 76F2 7740 7741 7742 7743 7744 774C \
    774E 775E 77AC 77B1 77B2 77D4 77D5 77D6 7885 \
"

KERNEL_DEVICETREE = "${@' '.join(["ni-%s.dtb" % x for x in "${NILRT_ARM_DEVICE_CODES}".split()])}"

# 793C is special, we only need to build its kernel & device tree, migration &
# other features are not supported (yet)
KERNEL_DEVICETREE += "ni-793C.dtb"
```

## recipes-bsp/zynq-itb/files/backwards_migrate.its
```
/dts-v1/;

/ {
	description = "NXG to older NIRT migration bootscript";
	version = "2.0";
	#address-cells = <1>;

	images {

		bootscript@1 {
			description = "Migrate from NXG to older NLIRT";
			data = /incbin/("./backwards_migrate.txt");
			type = "script";
			arch = "arm";
			compression = "none";
			hash@1 {
				algo = "crc32";
			};
		};

	};
};
```

## recipes-bsp/zynq-itb/files/forwards_migrate.its
```
/dts-v1/;

/ {
	description = "Older NILRT to NXG forwards migration bootscript";
	version = "2.0";
	#address-cells = <1>;

	images {

		bootscript@1 {
			description = "Migrate from older NILRT to NXG";
			data = /incbin/("./forwards_migrate.txt");
			type = "script";
			arch = "arm";
			compression = "none";
			hash@1 {
				algo = "crc32";
			};
		};

	};
};
```
